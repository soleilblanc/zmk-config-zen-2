## config/west.yml
```yaml
manifest:
  defaults:
    remote: urob
    revision: v0.2 # Pin everything to v0.2

  remotes:
    - name: zmkfirmware
      url-base: https://github.com/zmkfirmware
    - name: urob
      url-base: https://github.com/urob

  projects:
    - name: zmk
      remote: zmkfirmware
      revision: main
      import: app/west.yml

    # ZMK modules
    - name: zmk-adaptive-key
      path: modules/zmk/adaptive-key
    - name: zmk-auto-layer
      path: modules/zmk/auto-layer
    - name: zmk-tri-state
      path: modules/zmk/tri-state
    # - name: zmk-leader-key
    #   path: modules/zmk/leader-key

  self:
    path: config
```
